## boards/shields/zonkey/Kconfig.defconfig
```kconfig
if SHIELD_DYA_DASH_RIGHT

config ZMK_KEYBOARD_NAME
    default "zonkey"

config ZMK_SPLIT_ROLE_CENTRAL
    default y
endif

if SHIELD_ZONKEY_LEFT || SHIELD_ZONKEY_RIGHT
config ZMK_SPLIT
    default y
endif
```

## config/west.yml
```yaml
manifest:
  remotes:
    - name: zmkfirmware
      url-base: https://github.com/zmkfirmware
    - name: sekigon-gonnoc
      url-base: https://github.com/sekigon-gonnoc
    - name: gohanda11
      url-base: https://github.com/gohanda11
    - name: badjeff
      url-base: https://github.com/badjeff
    - name: pukuhei
      url-base: https://github.com/pukuhei  
  projects:
    - name: zmk
      remote: zmkfirmware
      revision: main
      import: app/west.yml
    - name: zmk-feature-non-lipo-battery-management
      remote: sekigon-gonnoc
      revision: main
    - name: zmk-pmw3610-driver
      remote: badjeff
      revision: main
    - name: zmk-rgbled-widget
      remote: gohanda11
      revision: fix/xiao-variant-overlays
    - name: zmk-tom-oled
      remote: pukuhei
      revision: main
  self:
    path: config
```
